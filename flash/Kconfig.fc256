## flash/Kconfig.fc256
```kconfig
menuconfig FC256
	bool
	prompt "fc256 driver"
	depends on I2C
	default y
	help
	 Enable FC256 driver configuration.

config FC256_DRV_NAME
	string "FC256 flash driver name"
	depends on FC256
	default "FC256_NAME"
	help
	 Specify the device name for the flash driver.

config FC256_I2C_MASTER
	string	
	depends on FC256
	default "I2C_0"
	help
	 Name of I2C bus to be used by the driver  

#endmenu
```
